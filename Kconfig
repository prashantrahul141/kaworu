## Kconfig
```kconfig
config PER_CPU_STACK_SIZE
    int "Stack size, should be 16 byte aligned"
    default 4096

config CPU_COUNT
    int "Hardware cpu count"
    default 4

config PHYSICAL_MEMORY_MB
    int "Physical memory the system has (in MB)"
    default 128

config DEBUG_CHECKS
    bool "Enable Debug checks"
    default y

config DEBUG_SYMBOLS
    bool "Enable debug symbols"
    default y

choice LOGGING_LEVEL
    prompt "Set level of logging"
    default LOGGING_LEVEL_DEBUG

    config LOGGING_LEVEL_TRACE
        bool "Trace"

    config LOGGING_LEVEL_DEBUG
        bool "Debug"

    config LOGGING_LEVEL_INFO
        bool "Info"

    config LOGGING_LEVEL_WARN
        bool "Warn"

    config LOGGING_LEVEL_ERROR
        bool "Error"
endchoice

choice OPTIMIZATIONS
    prompt "Optimizations level"
    default OPTIMIZATIONS_NONE

    config OPTIMIZATIONS_NONE
        bool "None"

    config OPTIMIZATIONS_LOW
        bool "Low"

    config OPTIMIZATIONS_MEDIUM
        bool "Medium"

    config OPTIMIZATIONS_HIGH
        bool "High"
endchoice
```
